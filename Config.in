## Config.in
```kconfig
source "$BR2_EXTERNAL_BUILDROOT_EXTERNAL_PATH/package/nextpnr/Config.in"
source "$BR2_EXTERNAL_BUILDROOT_EXTERNAL_PATH/package/icestorm/Config.in"
source "$BR2_EXTERNAL_BUILDROOT_EXTERNAL_PATH/package/yosys-abc/Config.in"
source "$BR2_EXTERNAL_BUILDROOT_EXTERNAL_PATH/package/yosys/Config.in"
```

## configs/digilent_arty_z7_defconfig
```kconfig
BR2_arm=y
BR2_cortex_a9=y
BR2_ARM_ENABLE_NEON=y
BR2_ARM_ENABLE_VFP=y
BR2_CCACHE=y
BR2_GLOBAL_PATCH_DIR="$(BR2_EXTERNAL_BUILDROOT_EXTERNAL_PATH)/board/arty_z7/patches"
BR2_KERNEL_HEADERS_5_10=y
BR2_TOOLCHAIN_BUILDROOT_WCHAR=y
BR2_TOOLCHAIN_BUILDROOT_CXX=y
BR2_TARGET_GENERIC_HOSTNAME="arty_z7"
BR2_TARGET_GENERIC_ISSUE="Welcome to Digilent Arty Z7"
BR2_ROOTFS_DEVICE_CREATION_DYNAMIC_MDEV=y
BR2_TARGET_GENERIC_ROOT_PASSWD="root"
BR2_TARGET_GENERIC_GETTY_PORT="ttyPS0"
BR2_ROOTFS_OVERLAY="$(BR2_EXTERNAL_BUILDROOT_EXTERNAL_PATH)/board/arty_z7/overlay"
BR2_ROOTFS_POST_BUILD_SCRIPT="$(BR2_EXTERNAL_BUILDROOT_EXTERNAL_PATH)/board/arty_z7/post-build.sh"
BR2_ROOTFS_POST_IMAGE_SCRIPT="$(BR2_EXTERNAL_BUILDROOT_EXTERNAL_PATH)/board/arty_z7/post-image.sh"
BR2_ROOTFS_POST_SCRIPT_ARGS="-c $(BR2_EXTERNAL_BUILDROOT_EXTERNAL_PATH)/board/arty_z7/genimage-template.cfg"
BR2_LINUX_KERNEL=y
BR2_LINUX_KERNEL_CUSTOM_GIT=y
BR2_LINUX_KERNEL_CUSTOM_REPO_URL="git://github.com/Xilinx/linux-xlnx.git"
BR2_LINUX_KERNEL_CUSTOM_REPO_VERSION="xilinx-v2021.2"
BR2_LINUX_KERNEL_DEFCONFIG="xilinx_zynq"
BR2_LINUX_KERNEL_CONFIG_FRAGMENT_FILES="$(BR2_EXTERNAL_BUILDROOT_EXTERNAL_PATH)/board/arty_z7/linux-$(BR2_LINUX_KERNEL_VERSION)_fragment"
BR2_LINUX_KERNEL_DTS_SUPPORT=y
BR2_LINUX_KERNEL_INTREE_DTS_NAME="zynq-arty-z7"
BR2_LINUX_KERNEL_DTB_OVERLAY_SUPPORT=y
BR2_PACKAGE_NFS_UTILS=y
BR2_PACKAGE_NFS_UTILS_RPC_LOCKD=y
BR2_PACKAGE_HAVEGED=y
BR2_PACKAGE_DROPBEAR=y
BR2_TARGET_ROOTFS_CPIO=y
BR2_TARGET_ROOTFS_CPIO_GZIP=y
BR2_TARGET_ROOTFS_CPIO_UIMAGE=y
BR2_TARGET_ROOTFS_EXT2=y
BR2_TARGET_ROOTFS_EXT2_4=y
BR2_TARGET_UBOOT=y
BR2_TARGET_UBOOT_BUILD_SYSTEM_KCONFIG=y
BR2_TARGET_UBOOT_CUSTOM_VERSION=y
BR2_TARGET_UBOOT_CUSTOM_VERSION_VALUE="2021.10"
BR2_TARGET_UBOOT_BOARD_DEFCONFIG="xilinx_zynq_virt"
BR2_TARGET_UBOOT_NEEDS_DTC=y
BR2_TARGET_UBOOT_NEEDS_OPENSSL=y
# BR2_TARGET_UBOOT_FORMAT_BIN is not set
BR2_TARGET_UBOOT_FORMAT_IMG=y
BR2_TARGET_UBOOT_SPL=y
BR2_TARGET_UBOOT_SPL_NAME="spl/boot.bin"
BR2_TARGET_UBOOT_CUSTOM_MAKEOPTS="DEVICE_TREE=zynq-arty-z7"
BR2_PACKAGE_HOST_DOSFSTOOLS=y
BR2_PACKAGE_HOST_GENIMAGE=y
BR2_PACKAGE_HOST_MTOOLS=y
```

## configs/zynqmp_AXU2CGA_defconfig
```kconfig
BR2_aarch64=y
BR2_TOOLCHAIN_EXTERNAL=y
BR2_TOOLCHAIN_EXTERNAL_BOOTLIN=y
BR2_TOOLCHAIN_EXTERNAL_BOOTLIN_AARCH64_GLIBC_STABLE=y
BR2_TOOLCHAIN_BARE_METAL_BUILDROOT=y
BR2_TOOLCHAIN_BARE_METAL_BUILDROOT_ARCH="microblazeel-buildroot-elf"
BR2_CCACHE=y
BR2_GLOBAL_PATCH_DIR="$(BR2_EXTERNAL_BUILDROOT_EXTERNAL_PATH)/board/AXU2CGA/patches/"
BR2_TARGET_GENERIC_ROOT_PASSWD="root"
BR2_ROOTFS_OVERLAY="$(BR2_EXTERNAL_BUILDROOT_EXTERNAL_PATH)/board/AXU2CGA/overlay"
BR2_ROOTFS_POST_IMAGE_SCRIPT="$(BR2_EXTERNAL_BUILDROOT_EXTERNAL_PATH)/board/AXU2CGA/post-image.sh"
BR2_LINUX_KERNEL=y
BR2_LINUX_KERNEL_CUSTOM_TARBALL=y
BR2_LINUX_KERNEL_CUSTOM_TARBALL_LOCATION="$(call github,Xilinx,linux-xlnx,xlnx_rebase_v6.12_LTS_merge_6.12.40)/xlnx_rebase_v6.12_LTS_merge_6.12.40.tar.gz"
BR2_LINUX_KERNEL_DEFCONFIG="xilinx"
BR2_LINUX_KERNEL_DTS_SUPPORT=y
BR2_LINUX_KERNEL_INTREE_DTS_NAME="xilinx/alinx-axu2cga"
BR2_LINUX_KERNEL_DTB_OVERLAY_SUPPORT=y
BR2_LINUX_KERNEL_NEEDS_HOST_OPENSSL=y
BR2_PACKAGE_LINUX_TOOLS_PCI=y
BR2_PACKAGE_HWDATA=y
BR2_PACKAGE_HWDATA_IAB_OUI_TXT=y
BR2_PACKAGE_HWDATA_PNP_IDS=y
BR2_PACKAGE_PCIUTILS=y
BR2_PACKAGE_RTC_TOOLS=y
BR2_PACKAGE_LIBPCIACCESS=y
BR2_PACKAGE_HAVEGED=y
BR2_PACKAGE_DROPBEAR=y
# BR2_PACKAGE_DROPBEAR_CLIENT is not set
BR2_PACKAGE_ETHTOOL=y
BR2_PACKAGE_PTPD2=y
BR2_PACKAGE_XILINX_FPGAUTIL=y
BR2_TARGET_ROOTFS_EXT2=y
BR2_TARGET_ROOTFS_EXT2_4=y
BR2_TARGET_ROOTFS_EXT2_LABEL=""
BR2_TARGET_ROOTFS_EXT2_SIZE="120M"
# BR2_TARGET_ROOTFS_TAR is not set
BR2_TARGET_ARM_TRUSTED_FIRMWARE=y
BR2_TARGET_ARM_TRUSTED_FIRMWARE_CUSTOM_TARBALL=y
BR2_TARGET_ARM_TRUSTED_FIRMWARE_CUSTOM_TARBALL_LOCATION="$(call github,Xilinx,arm-trusted-firmware,xlnx_rebase_v2.12_2025.1)/xlnx_rebase_v2.12_2025.1.tar.gz"
BR2_TARGET_ARM_TRUSTED_FIRMWARE_PLATFORM="zynqmp"
BR2_TARGET_ARM_TRUSTED_FIRMWARE_BL31_UBOOT=y
BR2_TARGET_UBOOT=y
BR2_TARGET_UBOOT_BUILD_SYSTEM_KCONFIG=y
BR2_TARGET_UBOOT_CUSTOM_TARBALL=y
BR2_TARGET_UBOOT_CUSTOM_TARBALL_LOCATION="$(call github,Xilinx,u-boot-xlnx,xlnx_rebase_v2025.01_2025.1)/xlnx_rebase_v2025.01_2025.1.tar.gz"
BR2_TARGET_UBOOT_BOARD_DEFCONFIG="xilinx_zynqmp_virt"
BR2_TARGET_UBOOT_CONFIG_FRAGMENT_FILES="$(BR2_EXTERNAL_BUILDROOT_EXTERNAL_PATH)/board/AXU2CGA/uboot_fragment"
BR2_TARGET_UBOOT_NEEDS_DTC=y
BR2_TARGET_UBOOT_NEEDS_OPENSSL=y
BR2_TARGET_UBOOT_NEEDS_GNUTLS=y
BR2_TARGET_UBOOT_NEEDS_UTIL_LINUX=y
BR2_TARGET_UBOOT_NEEDS_ATF_BL31=y
BR2_TARGET_UBOOT_USE_BINMAN=y
BR2_TARGET_UBOOT_FORMAT_ITB=y
BR2_TARGET_UBOOT_FORMAT_QSPI_BIN=y
BR2_TARGET_UBOOT_SPL=y
BR2_TARGET_UBOOT_SPL_NAME="spl/boot.bin"
BR2_TARGET_UBOOT_ZYNQMP=y
BR2_TARGET_UBOOT_ZYNQMP_PMUFW_EMBEDDEDSW=y
BR2_TARGET_UBOOT_ZYNQMP_PM_CFG="$(BR2_EXTERNAL_BUILDROOT_EXTERNAL_PATH)/board/AXU2CGA/pm_cfg_obj.c"
BR2_TARGET_UBOOT_CUSTOM_MAKEOPTS="DEVICE_TREE=alinx-axu2cga"
BR2_TARGET_XILINX_EMBEDDEDSW=y
BR2_TARGET_XILINX_EMBEDDEDSW_ZYNQMP_PMUFW=y
BR2_PACKAGE_HOST_DOSFSTOOLS=y
BR2_PACKAGE_HOST_GENIMAGE=y
BR2_PACKAGE_HOST_MTOOLS=y
```

## package/icestorm/Config.in
```kconfig
comment "icestorm needs python3"
	depends on !BR2_PACKAGE_PYTHON3

comment "icestorm needs a toolchain w/ gcc > 4.9"
	depends on !BR2_TOOLCHAIN_GCC_AT_LEAST_4_9

config BR2_PACKAGE_ICESTORM
	bool "icestorm"
	depends on BR2_TOOLCHAIN_GCC_AT_LEAST_4_9 # C++11
	depends on BR2_PACKAGE_PYTHON3

	help
	  Project IceStorm aims at documenting the bitstream format of
	  Lattice iCE40 FPGAs and providing simple tools for analyzing
	  and creating bitstream files.

	  http://www.clifford.at/icestorm/

if BR2_PACKAGE_ICESTORM

comment "iceprog needs a toolchain w/ threads"
	depends on !BR2_TOOLCHAIN_HAS_THREADS

config BR2_PACKAGE_ICESTORM_ICEPROG
	bool "iceprog"
	default y
	depends on BR2_TOOLCHAIN_HAS_THREADS # libftdi1
	select BR2_PACKAGE_LIBFTDI1

endif
```

## package/nextpnr/Config.in
```kconfig
comment "nextpnr needs python3"
	depends on !BR2_PACKAGE_PYTHON3

comment "nextpnr needs a toolchain w/ C++, threads, wchar"
	depends on BR2_USE_MMU
	depends on !BR2_INSTALL_LIBSTDCPP || \
		!BR2_TOOLCHAIN_HAS_THREADS || !BR2_USE_WCHAR

comment "nextpnr needs a toolchain not affected by GCC bug 43744 and 64735"
	depends on BR2_TOOLCHAIN_HAS_GCC_BUG_43744
	depends on BR2_TOOLCHAIN_HAS_GCC_BUG_64735

config BR2_PACKAGE_NEXTPNR
	bool "nextpnr"
	depends on BR2_USE_MMU # boost
	depends on BR2_INSTALL_LIBSTDCPP
	depends on BR2_PACKAGE_PYTHON3
	depends on BR2_TOOLCHAIN_HAS_THREADS # boost
	depends on BR2_USE_WCHAR # boost
	depends on BR2_TOOLCHAIN_SUPPORTS_ALWAYS_LOCKFREE_ATOMIC_INTS # boost-filesystem
	depends on !BR2_TOOLCHAIN_HAS_GCC_BUG_43744
	depends on !BR2_TOOLCHAIN_HAS_GCC_BUG_64735 # boost-thread
	select BR2_PACKAGE_BOOST
	select BR2_PACKAGE_BOOST_FILESYSTEM
	select BR2_PACKAGE_BOOST_PROGRAM_OPTIONS
	select BR2_PACKAGE_BOOST_THREAD
	select BR2_PACKAGE_BOOST_IOSTREAMS
	select BR2_PACKAGE_BOOST_SYSTEM

	help
	  nextpnr aims to be a vendor neutral, timing driven, FOSS FPGA
	  place and route tool.

	  https://github.com/yosyshq/nextpnr

if BR2_PACKAGE_NEXTPNR

config BR2_PACKAGE_NEXTPNR_GENERIC
	bool "generic arch"

comment "ice40 support needs icestorm"
	depends on !BR2_PACKAGE_ICESTORM

config BR2_PACKAGE_NEXTPNR_ICE40
	bool "ice40"
	depends on BR2_PACKAGE_ICESTORM

endif
```

## package/yosys-abc/Config.in
```kconfig
comment "yosys-abc needs a toolchain w/ NPTL"
	depends on !BR2_TOOLCHAIN_HAS_THREADS_NPTL

config BR2_PACKAGE_YOSYS_ABC
	bool "yosys-abc"
	depends on BR2_TOOLCHAIN_HAS_THREADS_NPTL
	select BR2_PACKAGE_READLINE

	help
	  ABC: System for Sequential Logic Synthesis and Formal Verification

	  https://www.github.com/YosysHQ/abc
```

## package/yosys/Config.in
```kconfig
comment "yosys needs a toolchain w/ C++, gcc > 4.8, threads and dynamic library"
	depends on BR2_USE_MMU
	depends on !BR2_INSTALL_LIBSTDCPP || \
		!BR2_TOOLCHAIN_GCC_AT_LEAST_4_9 || \
		BR2_STATIC_LIBS || \
		!BR2_TOOLCHAIN_HAS_THREADS

config BR2_PACKAGE_YOSYS
	bool "yosys"
	depends on BR2_USE_MMU
	depends on BR2_INSTALL_LIBSTDCPP
	depends on !BR2_STATIC_LIBS # dlopen()
	depends on BR2_TOOLCHAIN_HAS_THREADS
	depends on BR2_TOOLCHAIN_GCC_AT_LEAST_4_9 # C++11

	help
	  yosys : Yosys Open SYnthesis Suite

	  This is a framework for RTL synthesis tools. It currently has
	  extensive Verilog-2005 support and provides a basic set of
	  synthesis algorithms for various application domains.

	  https://www.github.com/YosysHQ/yosys

if BR2_PACKAGE_YOSYS

config BR2_PACKAGE_YOSYS_TCL
	bool "tcl"
	default y
	select BR2_PACKAGE_TCL
	help
	  TCL support

config BR2_PACKAGE_YOSYS_LIBYOSYS
	bool "libosys"
	help
	  pyosys support

comment "pyosys needs python3"
	depends on !BR2_PACKAGE_PYTHON3
comment "pyosys needs a toolchain w/ wchar"
	depends on !BR2_USE_WCHAR

config BR2_PACKAGE_YOSYS_PYOSYS
	bool "pyosys"
	depends on BR2_PACKAGE_PYTHON3
	depends on BR2_TOOLCHAIN_SUPPORTS_ALWAYS_LOCKFREE_ATOMIC_INTS # boost-filesystem
	depends on BR2_USE_WCHAR # boost,python3
	select BR2_PACKAGE_BOOST
	select BR2_PACKAGE_BOOST_SYSTEM
	select BR2_PACKAGE_BOOST_FILESYSTEM
	select BR2_PACKAGE_BOOST_PYTHON
	select BR2_PACKAGE_YOSYS_LIBYOSYS
	help
	  pyosys support

config BR2_PACKAGE_YOSYS_GLOB
	bool "glob"
	default y
	help
	  GLOB support

config BR2_PACKAGE_YOSYS_PLUGINS
	bool "plugins"
	default y
	select BR2_PACKAGE_LIBFFI
	help
	  plugins support

config BR2_PACKAGE_YOSYS_READLINE
	bool "readline"
	default y
	select BR2_PACKAGE_READLINE
	help
	  readline support

config BR2_PACKAGE_YOSYS_ZLIB
	bool "zlib"
	default y
	select BR2_PACKAGE_ZLIB
	help
	  zlib support

endif
```
